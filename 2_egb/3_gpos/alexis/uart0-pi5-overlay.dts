/dts-v1/;
/plugin/;

/{
	compatible = "brcm,bcm2712";

	fragment@0 {
		target = <&uart0>;
		__overlay__ {
			egb_uart: egb_uart@0 {
				compatible = "td3,egb_uart";
				status = "okay";
			};
		};
	};
};